## thermocouple-mcp9601-simulator/main/Kconfig.projbuild
```kconfig
menu "MCP9601 simulator"

config MCP9601_SIMULATOR_OLED
    bool "Enable optional SSD1306 OLED display"
    default y
    help
        Show the simulated MCP9601 temperature on a 128x32 SSD1306 OLED at
        address 0x3C. The OLED uses the independent I2C controller on GPIO 8
        (SDA) and GPIO 9 (SCL). The simulator continues normally when the
        display is enabled but not connected.

endmenu
```

## thermocouple-mcp9601-simulator/sdkconfig.defaults
```kconfig
CONFIG_IDF_TARGET="esp32s3"
CONFIG_ESPTOOLPY_FLASHSIZE_8MB=y
CONFIG_I2C_ENABLE_SLAVE_DRIVER_VERSION_2=y
CONFIG_ESP_CONSOLE_UART_DEFAULT=y
CONFIG_ESP_CONSOLE_UART_BAUDRATE=115200
CONFIG_LOG_DEFAULT_LEVEL_INFO=y
```

## thermostat-mcp9600-simulator/main/Kconfig.projbuild
```kconfig
menu "MCP9600 simulator"

config MCP9600_SIMULATOR_OLED
    bool "Enable optional SSD1306 OLED display"
    default y
    help
        Show the simulated MCP9600 temperature on a 128x32 SSD1306 OLED at
        address 0x3C. The OLED uses the independent I2C controller on GPIO 8
        (SDA) and GPIO 9 (SCL). The simulator continues normally when the
        display is enabled but not connected.

endmenu
```
